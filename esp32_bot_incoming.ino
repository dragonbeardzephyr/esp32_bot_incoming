#include <SPI.h>
#include <Wire.h>
#include <Adafruit_GFX.h>
#include <Adafruit_SSD1306.h>
#include <ESP32Servo.h>
#include <math.h>
#include <Adafruit_MPU6050.h>
#include <Adafruit_Sensor.h>

#define SCREEN_WIDTH 128 // OLED display width, in pixels
#define SCREEN_HEIGHT 64 // OLED display height, in pixels

#define OLED_RESET     -1 // Reset pin # (or -1 if sharing Arduino reset pin)
#define SCREEN_ADDRESS 0x3C 
Adafruit_SSD1306 display(SCREEN_WIDTH, SCREEN_HEIGHT, &Wire, OLED_RESET);

Adafruit_MPU6050 mpu;
bool mpuOnline = false;

#define SERVO_PIN 13
#define TRIG_PIN 18
#define ECHO_PIN 19
#define SPEAKER_PIN 27
#define LASER_PIN 25

#define MOTOR_LEFT_IN1    26   // Left Motor FWD
#define MOTOR_LEFT_IN2    14   // Left Motor REV
#define MOTOR_RIGHT_IN3   5    // Right Motor FWD
#define MOTOR_RIGHT_IN4   4    // Right Motor REV

const int PWM_FREQ = 20000;
const int PWM_RES  = 8;

Servo headServo;
// Laser Arm angle in degrees
int zeroAngle = 90; // Centre
int angle = 90;
int angleDiff = 0;

float laserX = 2;// distance between servo and ultra sonic sensor
float laserY = 5; // 5 cm off the ground

long face_distance; // result for ultrasonic sensor

unsigned long armUpTime = 0;



void laserOn() {digitalWrite(LASER_PIN, HIGH);}

void laserOf() {digitalWrite(LASER_PIN, LOW);}


int measureDistance() {
  long distance;
  digitalWrite(TRIG_PIN, LOW);
  delayMicroseconds(2);
  digitalWrite(TRIG_PIN, HIGH);
  delayMicroseconds(10);
  digitalWrite(TRIG_PIN, LOW);
  
  long duration = pulseIn(ECHO_PIN, HIGH, 15000); // 2.5 metre range
  
  if (duration == 0) {
    distance = -1;
  } else {
    distance = duration * 0.0343 / 2;
  }

  return distance;
}




void driveMotors(int leftSpeed, int rightSpeed) {

  if (leftSpeed > 0) {
    analogWrite(MOTOR_LEFT_IN1, constrain(leftSpeed, 0, 255));
    analogWrite(MOTOR_LEFT_IN2, 0);
  } else if (leftSpeed < 0) {
    analogWrite(MOTOR_LEFT_IN1, 0);
    analogWrite(MOTOR_LEFT_IN2, constrain(-leftSpeed, 0, 255));
  } else {
    analogWrite(MOTOR_LEFT_IN1, 0);
    analogWrite(MOTOR_LEFT_IN2, 0);
  }

  // Right Motor
  if (rightSpeed > 0) {
    analogWrite(MOTOR_RIGHT_IN3, constrain(rightSpeed, 0, 255));
    analogWrite(MOTOR_RIGHT_IN4, 0);
  } else if (rightSpeed < 0) {
    analogWrite(MOTOR_RIGHT_IN3, 0);
    analogWrite(MOTOR_RIGHT_IN4, constrain(-rightSpeed, 0, 255));
  } else {
    analogWrite(MOTOR_RIGHT_IN3, 0);
    analogWrite(MOTOR_RIGHT_IN4, 0);
  }

}

void setup() {

  Serial.begin(115200);
  Wire.begin(21, 22);
  Wire.setClock(50000);

  //while (!Serial)
  //  delay(10);

  delay(150);

  // Send wake-up byte to power management register (0x6B = 0)
  Wire.beginTransmission(0x68);
  Wire.write(0x6B);
  Wire.write(0x00);
  byte wakeErr = Wire.endTransmission();
  
  Serial.print("Wake-up ping error (0 = OK): ");
  Serial.println(wakeErr);
  delay(50);

  if (mpu.begin(0x68, &Wire)) {
    Serial.println("MPU6050 Initialized successfully!");
    mpu.setAccelerometerRange(MPU6050_RANGE_4_G);
    mpu.setGyroRange(MPU6050_RANGE_500_DEG);
    mpu.setFilterBandwidth(MPU6050_BAND_21_HZ);
    mpuOnline = true;
  } else {
    Serial.println("ERROR: mpu.begin() returned false!");
  }
  

  Serial.println("Adafruit MPU6050 test!");

  ESP32PWM::allocateTimer(0);
  ESP32PWM::allocateTimer(1);
  ESP32PWM::allocateTimer(2);
  ESP32PWM::allocateTimer(3);

  headServo.setPeriodHertz(50); // Standard 50Hz servo
  headServo.attach(SERVO_PIN, 500, 2400); // Pulse min/max in microseconds
  
  headServo.write(90); // Center head

  pinMode(MOTOR_LEFT_IN1, OUTPUT);
  pinMode(MOTOR_LEFT_IN2, OUTPUT);
  pinMode(MOTOR_RIGHT_IN3, OUTPUT);
  pinMode(MOTOR_RIGHT_IN4, OUTPUT);

  pinMode(TRIG_PIN, OUTPUT);
  pinMode(ECHO_PIN, INPUT);

  pinMode(SPEAKER_PIN, OUTPUT);

  pinMode(LASER_PIN, OUTPUT);

  laserOn();


  // SSD1306_SWITCHCAPVCC = generate display voltage from 3.3V internally
  if(!display.begin(SSD1306_SWITCHCAPVCC, SCREEN_ADDRESS)) {
    Serial.println(F("SSD1306 allocation failed - check bus!"));
  } else {
    display.setTextColor(SSD1306_WHITE);
    display.clearDisplay();
  }


  display.setTextColor(SSD1306_WHITE);
  display.clearDisplay();
  

}

void loop() {

  delay(40);

  display.clearDisplay();

  display.setCursor(0, 4);
  display.setTextSize(1);

  face_distance = measureDistance();

  display.print(face_distance);
  display.println(" cm");

  if (mpuOnline) {
    sensors_event_t a, g, temp;
    mpu.getEvent(&a, &g, &temp);

    Serial.print(" | Acc (m/s^2) [X: ");
    Serial.print(a.acceleration.x, 1);
    Serial.print(" Y: ");
    Serial.print(a.acceleration.y, 1);
    Serial.print(" Z: ");
    Serial.print(a.acceleration.z, 1);

    Serial.print(" | Temp: ");
    Serial.print(temp.temperature, 1);
    Serial.print(" °C");

    //Serial.print("] | Gyro (deg/s) [Z: ");
    //Serial.print(g.gyro.z * 57.2958, 1); // converted to deg/sec for yaw/turning
    Serial.print("]");
  }

  Serial.println();


  display.display();

  //driveMotors(constrain(face_distance, -255, 255), constrain(face_distance, -255, 255));

  driveMotors(200, 200);

  // Sonar Sensor workings
  if (face_distance > 0 && face_distance <= 150) {
    laserOn();

    //tone(SPEAKER_PIN, face_distance*10, 200);

    float horizontalDistance = face_distance + laserX;

    angleDiff = round(atan2((float)laserY, horizontalDistance) * (180 / M_PI));

    angle = zeroAngle - angleDiff;

    Serial.println(zeroAngle - angleDiff);

  } 
  else if (face_distance > 150 && face_distance <= 250) {

    int newAngle = angle + (7 - (esp_random() % 12)); // -5 to 5

    angle = constrain(newAngle, angle-5, angle+7);

    if (millis() - armUpTime > 500) {
      tone(SPEAKER_PIN, face_distance*7.5, 100);
      
      if ((esp_random() % 50) == 0){
        angle = 90 - angle;
      }
      
    }

    Serial.println(angle);

  }
  else {
    noTone(SPEAKER_PIN);
    angle = zeroAngle;
    laserOn();
  }


  // IR Sensor Workings


  // Accelerometer Sensing

  // 


  angle = constrain(angle, 35, 180);
  headServo.write(angle);  // Look left
  


   
}



















void testdrawline() {
  int16_t i;

  display.clearDisplay(); // Clear display buffer

  for(i=0; i<display.width(); i+=4) {
    display.drawLine(0, 0, i, display.height()-1, SSD1306_WHITE);
    display.display(); // Update screen with each newly-drawn line
    delay(1);
  }
  for(i=0; i<display.height(); i+=4) {
    display.drawLine(0, 0, display.width()-1, i, SSD1306_WHITE);
    display.display();
    delay(1);
  }
  delay(250);

  display.clearDisplay();

  for(i=0; i<display.width(); i+=4) {
    display.drawLine(0, display.height()-1, i, 0, SSD1306_WHITE);
    display.display();
    delay(1);
  }
  for(i=display.height()-1; i>=0; i-=4) {
    display.drawLine(0, display.height()-1, display.width()-1, i, SSD1306_WHITE);
    display.display();
    delay(1);
  }
  delay(250);

  display.clearDisplay();

  for(i=display.width()-1; i>=0; i-=4) {
    display.drawLine(display.width()-1, display.height()-1, i, 0, SSD1306_WHITE);
    display.display();
    delay(1);
  }
  for(i=display.height()-1; i>=0; i-=4) {
    display.drawLine(display.width()-1, display.height()-1, 0, i, SSD1306_WHITE);
    display.display();
    delay(1);
  }
  delay(250);

  display.clearDisplay();

  for(i=0; i<display.height(); i+=4) {
    display.drawLine(display.width()-1, 0, 0, i, SSD1306_WHITE);
    display.display();
    delay(1);
  }
  for(i=0; i<display.width(); i+=4) {
    display.drawLine(display.width()-1, 0, i, display.height()-1, SSD1306_WHITE);
    display.display();
    delay(1);
  }

  delay(2000); // Pause for 2 seconds
}

void testdrawrect(void) {
  display.clearDisplay();

  for(int16_t i=0; i<display.height()/2; i+=2) {
    display.drawRect(i, i, display.width()-2*i, display.height()-2*i, SSD1306_WHITE);
    display.display(); // Update screen with each newly-drawn rectangle
    delay(1);
  }

  delay(2000);
}

void testfillrect(void) {
  display.clearDisplay();

  for(int16_t i=0; i<display.height()/2; i+=3) {
    // The INVERSE color is used so rectangles alternate white/black
    display.fillRect(i, i, display.width()-i*2, display.height()-i*2, SSD1306_INVERSE);
    display.display(); // Update screen with each newly-drawn rectangle
    delay(1);
  }

  delay(2000);
}

void testdrawcircle(void) {
  display.clearDisplay();

  for(int16_t i=0; i<max(display.width(),display.height())/2; i+=2) {
    display.drawCircle(display.width()/2, display.height()/2, i, SSD1306_WHITE);
    display.display();
    delay(1);
  }

  delay(2000);
}

void testfillcircle(void) {
  display.clearDisplay();

  for(int16_t i=max(display.width(),display.height())/2; i>0; i-=3) {
    // The INVERSE color is used so circles alternate white/black
    display.fillCircle(display.width() / 2, display.height() / 2, i, SSD1306_INVERSE);
    display.display(); // Update screen with each newly-drawn circle
    delay(1);
  }

  delay(2000);
}

void testdrawroundrect(void) {
  display.clearDisplay();

  for(int16_t i=0; i<display.height()/2-2; i+=2) {
    display.drawRoundRect(i, i, display.width()-2*i, display.height()-2*i,
      display.height()/4, SSD1306_WHITE);
    display.display();
    delay(1);
  }

  delay(2000);
}

void testfillroundrect(void) {
  display.clearDisplay();

  for(int16_t i=0; i<display.height()/2-2; i+=2) {
    // The INVERSE color is used so round-rects alternate white/black
    display.fillRoundRect(i, i, display.width()-2*i, display.height()-2*i,
      display.height()/4, SSD1306_INVERSE);
    display.display();
    delay(1);
  }

  delay(2000);
}

void testdrawtriangle(void) {
  display.clearDisplay();

  for(int16_t i=0; i<max(display.width(),display.height())/2; i+=5) {
    display.drawTriangle(
      display.width()/2  , display.height()/2-i,
      display.width()/2-i, display.height()/2+i,
      display.width()/2+i, display.height()/2+i, SSD1306_WHITE);
    display.display();
    delay(1);
  }

  delay(2000);
}

void testfilltriangle(void) {
  display.clearDisplay();

  for(int16_t i=max(display.width(),display.height())/2; i>0; i-=5) {
    // The INVERSE color is used so triangles alternate white/black
    display.fillTriangle(
      display.width()/2  , display.height()/2-i,
      display.width()/2-i, display.height()/2+i,
      display.width()/2+i, display.height()/2+i, SSD1306_INVERSE);
    display.display();
    delay(1);
  }

  delay(2000);
}

void testdrawchar(void) {
  display.clearDisplay();

  display.setTextSize(1);      // Normal 1:1 pixel scale
  display.setTextColor(SSD1306_WHITE); // Draw white text
  display.setCursor(0, 0);     // Start at top-left corner
  display.cp437(true);         // Use full 256 char 'Code Page 437' font

  // Not all the characters will fit on the display. This is normal.
  // Library will draw what it can and the rest will be clipped.
  for(int16_t i=0; i<256; i++) {
    if(i == '\n') display.write(' ');
    else          display.write(i);
  }

  display.display();
  delay(2000);
}

void testdrawstyles(void) {
  display.clearDisplay();

  display.setTextSize(1);             // Normal 1:1 pixel scale
  display.setTextColor(SSD1306_WHITE);        // Draw white text
  display.setCursor(0,0);             // Start at top-left corner
  display.println(F("Hello, world!"));

  display.setTextColor(SSD1306_BLACK, SSD1306_WHITE); // Draw 'inverse' text
  display.println(3.141592);

  display.setTextSize(2);             // Draw 2X-scale text
  display.setTextColor(SSD1306_WHITE);
  display.print(F("0x")); display.println(0xDEADBEEF, HEX);

  display.display();
  delay(2000);
}

void testscrolltext(void) {
  display.clearDisplay();

  display.setTextSize(2); // Draw 2X-scale text
  display.setTextColor(SSD1306_WHITE);
  display.setCursor(10, 0);
  display.println(F("scroll"));
  display.display();      // Show initial text
  delay(100);

  // Scroll in various directions, pausing in-between:
  display.startscrollright(0x00, 0x0F);
  delay(2000);
  display.stopscroll();
  delay(1000);
  display.startscrollleft(0x00, 0x0F);
  delay(2000);
  display.stopscroll();
  delay(1000);
  display.startscrolldiagright(0x00, 0x07);
  delay(2000);
  display.startscrolldiagleft(0x00, 0x07);
  delay(2000);
  display.stopscroll();
  delay(1000);
}




const unsigned char epd_bitmap_Bitmap [] PROGMEM = //mimikyu
{
	// 'mimikyu', 96x96px
	0x00, 0x00, 0x00, 0x00, 0x00, 0x00, 0x00, 0x00, 0x00, 0x00, 0x00, 0x00, 0x00, 0x00, 0x00, 0x00, 
	0x00, 0x00, 0x00, 0x00, 0x00, 0x00, 0x00, 0x00, 0x00, 0x00, 0x00, 0x00, 0x00, 0x00, 0x00, 0x00, 
	0x00, 0x00, 0x00, 0x00, 0x00, 0x00, 0x00, 0x00, 0x00, 0x00, 0x00, 0x00, 0x00, 0x00, 0x00, 0x00, 
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	0x00, 0x00, 0x00, 0x00, 0x00, 0x00, 0x00, 0x00, 0x00, 0x00, 0x00, 0x00, 0x00, 0x00, 0x00, 0x00
};

